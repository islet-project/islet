system.reset

system.cpu ARMV8-A
;system.config corenumber 8.

;core.assign 1. 2. 3. 4. 5. 6. 7. 8.

sys.up

d.load.elf ../out/aarch64-unknown-none-softfloat/release/fvp /nocode
Data.LOAD.Elf ../third-party/nw-linux/vmlinux /NoCODE /noclear

list
register

break.set HX:rmm_entry

go
