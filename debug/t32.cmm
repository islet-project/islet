system.reset

system.cpu CORTEXA72A53
system.config corenumber 8.

core.assign 1. 2. 3. 4. 5. 6. 7. 8.

sys.up

d.load.elf ../out/aarch64-unknown-none-softfloat/release/rmm /nocode

list
register

break.set HX:rmm_entry

go
